// Generated by CIRCT firtool-1.149.0
module UartTx(
  input        clock,
               reset,
               io_start,
  input  [7:0] io_data,
  output       io_tx,
               io_ready
);

  reg       busy;
  reg       txReg;
  reg [8:0] bitTimer;
  reg [3:0] bitIndex;
  reg [9:0] shifter;
  always @(posedge clock) begin
    if (reset) begin
      busy <= 1'h0;
      txReg <= 1'h1;
      bitTimer <= 9'h0;
      bitIndex <= 4'h0;
      shifter <= 10'h3FF;
    end
    else begin
      automatic logic _GEN = io_start & ~busy;
      automatic logic _GEN_0;
      automatic logic _GEN_1;
      automatic logic _GEN_2 = bitIndex == 4'h9;
      _GEN_0 = bitTimer == 9'h0;
      _GEN_1 = busy & _GEN_0;
      busy <= _GEN | ~(busy & _GEN_0 & _GEN_2) & busy;
      txReg <= ~_GEN & (_GEN_1 ? _GEN_2 | shifter[1] : txReg);
      if (_GEN) begin
        bitTimer <= 9'h1B1;
        bitIndex <= 4'h0;
        shifter <= {1'h1, io_data, 1'h0};
      end
      else begin
        if (busy)
          bitTimer <= _GEN_0 ? 9'h1B1 : bitTimer - 9'h1;
        if (_GEN_1) begin
          bitIndex <= bitIndex + 4'h1;
          shifter <= {1'h1, shifter[9:1]};
        end
      end
    end
  end // always @(posedge)
  assign io_tx = txReg;
  assign io_ready = ~busy;
endmodule

