// Generated by CIRCT firtool-1.149.0
module UartRx(
  input        clock,
               reset,
               io_rx,
  output [7:0] io_data,
  output       io_valid
);

  reg       rxMeta;
  reg       rxSync;
  reg [7:0] dataReg;
  reg [8:0] bitTimer;
  reg [2:0] bitIndex;
  reg [8:0] idleHighCount;
  reg       validReg;
  reg [1:0] state;
  always @(posedge clock) begin
    if (reset) begin
      rxMeta <= 1'h1;
      rxSync <= 1'h1;
      dataReg <= 8'h0;
      bitTimer <= 9'h0;
      bitIndex <= 3'h0;
      idleHighCount <= 9'h0;
      validReg <= 1'h0;
      state <= 2'h0;
    end
    else begin
      automatic logic            _GEN;
      automatic logic            _GEN_0 = state == 2'h0;
      automatic logic            _GEN_1;
      automatic logic            _GEN_2;
      automatic logic            _GEN_3;
      automatic logic            _GEN_4;
      automatic logic            _GEN_5;
      automatic logic [3:0][8:0] _GEN_6;
      automatic logic [3:0][1:0] _GEN_7;
      _GEN = idleHighCount == 9'h1B1;
      _GEN_1 = ~rxSync & _GEN;
      _GEN_2 = state == 2'h1;
      _GEN_3 = bitTimer == 9'h0;
      _GEN_4 = state == 2'h2;
      _GEN_5 = (&state) & _GEN_3;
      rxMeta <= io_rx;
      rxSync <= rxMeta;
      if (_GEN_0) begin
        if (_GEN_1)
          dataReg <= 8'h0;
      end
      else begin
        automatic logic _GEN_8;
        _GEN_8 = _GEN_4 & _GEN_3;
        if (_GEN_2 | ~_GEN_8) begin
        end
        else begin
          automatic logic [7:0] _dataReg_T = 8'h1 << bitIndex;
          dataReg <= rxSync ? dataReg | _dataReg_T : ~(~dataReg | _dataReg_T);
        end
        if (_GEN_2) begin
          if (_GEN_3 & ~rxSync)
            bitIndex <= 3'h0;
        end
        else if (~_GEN_8 | (&bitIndex)) begin
        end
        else
          bitIndex <= bitIndex + 3'h1;
      end
      _GEN_6 =
        {{~(&state) | _GEN_3 ? bitTimer : bitTimer - 9'h1},
         {_GEN_3 ? 9'h1B1 : bitTimer - 9'h1},
         {_GEN_3 ? (rxSync ? bitTimer : 9'h1B1) : bitTimer - 9'h1},
         {_GEN_1 ? 9'hD8 : bitTimer}};
      bitTimer <= _GEN_6[state];
      if (rxSync) begin
        if (~_GEN)
          idleHighCount <= idleHighCount + 9'h1;
      end
      else
        idleHighCount <= 9'h0;
      validReg <= ~(_GEN_0 | _GEN_2 | _GEN_4) & _GEN_5 & rxSync;
      _GEN_7 =
        {{_GEN_5 ? 2'h0 : state},
         {_GEN_3 & (&bitIndex) ? 2'h3 : state},
         {_GEN_3 ? {~rxSync, 1'h0} : state},
         {_GEN_1 ? 2'h1 : state}};
      state <= _GEN_7[state];
    end
  end // always @(posedge)
  assign io_data = dataReg;
  assign io_valid = validReg;
endmodule

