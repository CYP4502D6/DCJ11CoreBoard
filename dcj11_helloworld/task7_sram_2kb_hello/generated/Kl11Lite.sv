// Generated by CIRCT firtool-1.149.0
module Kl11Lite(
  input         clock,
                reset,
                io_busStrobe,
                io_busRead,
                io_busWrite,
  input  [21:0] io_busAddr,
  input  [15:0] io_busWdata,
  output        io_busHit,
  output [15:0] io_busRdata,
  output        io_irq,
  input         io_uartRx,
                io_txReady,
  output        io_txStart,
  output [7:0]  io_txData
);

  wire       _txQueue_io_enq_ready;
  wire       _txQueue_io_deq_valid;
  wire [7:0] _rx_io_data;
  wire       _rx_io_valid;
  reg        rxReady;
  reg  [7:0] rxData;
  reg        rxIntEnable;
  reg        txIntEnable;
  wire       txVisibleReady = ~_txQueue_io_deq_valid & io_txReady;
  wire       hitRcsr = io_busAddr == 22'h3FFF70;
  wire       hitRbuf = io_busAddr == 22'h3FFF72;
  wire       hitXcsr = io_busAddr == 22'h3FFF74;
  wire       hitXbuf = io_busAddr == 22'h3FFF76;
  wire       hit = hitRcsr | hitRbuf | hitXcsr | hitXbuf;
  wire       _GEN = io_busStrobe & hit & io_busWrite;
  always @(posedge clock) begin
    if (reset) begin
      rxReady <= 1'h0;
      rxData <= 8'h0;
      rxIntEnable <= 1'h0;
      txIntEnable <= 1'h0;
    end
    else begin
      rxReady <= ~(io_busStrobe & hitRbuf & io_busRead) & (_rx_io_valid | rxReady);
      if (_rx_io_valid)
        rxData <= _rx_io_data;
      if (_GEN & hitRcsr)
        rxIntEnable <= io_busWdata[6];
      if (_GEN & hitXcsr)
        txIntEnable <= io_busWdata[6];
    end
  end // always @(posedge)
  UartRx rx (
    .clock    (clock),
    .reset    (reset),
    .io_rx    (io_uartRx),
    .io_data  (_rx_io_data),
    .io_valid (_rx_io_valid)
  );
  Queue64_UInt8 txQueue (
    .clock        (clock),
    .reset        (reset),
    .io_enq_ready (_txQueue_io_enq_ready),
    .io_enq_valid (_GEN & hitXbuf & _txQueue_io_enq_ready),
    .io_enq_bits  (io_busWdata[7:0]),
    .io_deq_ready (io_txReady),
    .io_deq_valid (_txQueue_io_deq_valid),
    .io_deq_bits  (io_txData)
  );
  assign io_busHit = hit;
  assign io_busRdata =
    hitRcsr
      ? {8'h0, rxReady, rxIntEnable, 6'h0}
      : hitRbuf
          ? {8'h0, rxData}
          : hitXcsr ? {8'h0, txVisibleReady, txIntEnable, 6'h0} : 16'h0;
  assign io_irq = rxIntEnable & rxReady | txIntEnable & txVisibleReady;
  assign io_txStart = _txQueue_io_deq_valid & io_txReady;
endmodule

