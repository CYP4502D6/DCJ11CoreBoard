// Generated by CIRCT firtool-1.149.0
module Pc11Reader(
  input         clock,
                reset,
                io_busStrobe,
                io_busRead,
                io_busWrite,
  input  [21:0] io_busAddr,
  input  [15:0] io_busWdata,
  output        io_busHit,
  output [15:0] io_busRdata,
  output        io_irq,
  input         io_irqAck,
  output [15:0] io_irqVector,
  input         io_tapeValid,
  input  [7:0]  io_tapeData,
  output        io_tapeReady,
  input         io_tapeDone,
                io_tapeError,
  output        io_punchValid,
  output [7:0]  io_punchData,
  input         io_punchReady
);

  wire       hitCsr = io_busAddr == 22'h3FFF68 | io_busAddr[15:0] == 16'hFF68;
  wire       hitBuf = io_busAddr == 22'h3FFF6A | io_busAddr[15:0] == 16'hFF6A;
  wire       hitPunchCsr = io_busAddr == 22'h3FFF6C | io_busAddr[15:0] == 16'hFF6C;
  wire       hitPunchBuf = io_busAddr == 22'h3FFF6E | io_busAddr[15:0] == 16'hFF6E;
  reg        done;
  reg        busy;
  reg        intEnable;
  reg        punchIntEnable;
  reg  [7:0] data;
  reg  [7:0] punchData;
  reg        punchRequest;
  reg        errorSeen;
  reg        readerIrq;
  reg        punchIrq;
  reg        donePrev;
  reg        punchReadyPrev;
  wire       io_tapeReady_0 = busy & ~done;
  always @(posedge clock) begin
    if (reset) begin
      done <= 1'h0;
      busy <= 1'h0;
      intEnable <= 1'h0;
      punchIntEnable <= 1'h0;
      data <= 8'h0;
      punchData <= 8'h0;
      punchRequest <= 1'h0;
      errorSeen <= 1'h0;
      readerIrq <= 1'h0;
      punchIrq <= 1'h0;
      donePrev <= 1'h0;
      punchReadyPrev <= 1'h0;
    end
    else begin
      automatic logic writePunch = io_busStrobe & hitPunchBuf & io_busWrite;
      automatic logic _GEN = io_tapeValid & io_tapeReady_0;
      automatic logic _GEN_0 = io_busStrobe & hitCsr & io_busWrite;
      automatic logic _GEN_1 = _GEN_0 & io_busWdata[0];
      automatic logic _GEN_2 = hitBuf & io_busRead | _GEN_1;
      done <= ~_GEN_2 & (_GEN | done);
      busy <= _GEN_1 ? ~io_tapeDone & ~io_tapeError : ~(io_tapeError | _GEN) & busy;
      if (_GEN_0)
        intEnable <= io_busWdata[6];
      if (io_busStrobe & hitPunchCsr & io_busWrite)
        punchIntEnable <= io_busWdata[6];
      if (_GEN)
        data <= io_tapeData;
      if (writePunch)
        punchData <= io_busWdata[7:0];
      punchRequest <=
        writePunch ? io_punchReady | punchRequest : io_punchReady & punchRequest;
      errorSeen <= io_tapeError | errorSeen;
      readerIrq <=
        ~(io_irqAck & readerIrq) & (done & ~donePrev & intEnable | ~_GEN_2 & readerIrq);
      punchIrq <=
        (~io_irqAck | readerIrq)
        & (io_punchReady & ~punchReadyPrev & punchIntEnable | punchIrq);
      donePrev <= done;
      punchReadyPrev <= io_punchReady;
    end
  end // always @(posedge)
  assign io_busHit = hitCsr | hitBuf | hitPunchCsr | hitPunchBuf;
  assign io_busRdata =
    hitBuf
      ? {8'h0, data}
      : hitPunchCsr
          ? {errorSeen, 7'h0, io_punchReady, punchIntEnable, 6'h0}
          : hitPunchBuf
              ? {8'h0, punchData}
              : {errorSeen, 3'h0, busy, 3'h0, done, intEnable, 6'h0};
  assign io_irq = readerIrq | punchIrq;
  assign io_irqVector = readerIrq ? 16'h38 : punchIrq ? 16'h3C : 16'h0;
  assign io_tapeReady = io_tapeReady_0;
  assign io_punchValid = punchRequest;
  assign io_punchData = punchData;
endmodule

