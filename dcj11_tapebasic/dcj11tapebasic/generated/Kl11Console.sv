// Generated by CIRCT firtool-1.149.0
module Kl11Console(
  input         clock,
                reset,
                io_busStrobe,
                io_busRead,
                io_busWrite,
  input  [21:0] io_busAddr,
  input  [15:0] io_busWdata,
  output        io_busHit,
  output [15:0] io_busRdata,
  output        io_irq,
  input         io_irqAck,
  output [15:0] io_irqVector,
  input         io_uartRx,
                io_txReady,
  output        io_txStart,
  output [7:0]  io_txData
);

  wire       _txQueue_io_enq_ready;
  wire       _txQueue_io_deq_valid;
  wire [7:0] _rx_io_data;
  wire       _rx_io_valid;
  reg        rxReady;
  reg  [7:0] rxData;
  reg        rxIntEnable;
  reg        txIntEnable;
  reg        rxIrq;
  reg        txIrq;
  wire       txVisibleReady = ~_txQueue_io_deq_valid & io_txReady;
  reg        txVisibleReadyPrev;
  wire       hitRcsr = io_busAddr == 22'h3FFF70 | io_busAddr[15:0] == 16'hFF70;
  wire       hitRbuf = io_busAddr == 22'h3FFF72 | io_busAddr[15:0] == 16'hFF72;
  wire       hitXcsr = io_busAddr == 22'h3FFF74 | io_busAddr[15:0] == 16'hFF74;
  wire       hitXbuf = io_busAddr == 22'h3FFF76 | io_busAddr[15:0] == 16'hFF76;
  wire       hit = hitRcsr | hitRbuf | hitXcsr | hitXbuf;
  wire       _GEN = io_busStrobe & hit & io_busWrite;
  wire       _GEN_0 = hitXbuf & _txQueue_io_enq_ready;
  always @(posedge clock) begin
    if (reset) begin
      rxReady <= 1'h0;
      rxData <= 8'h0;
      rxIntEnable <= 1'h0;
      txIntEnable <= 1'h0;
      rxIrq <= 1'h0;
      txIrq <= 1'h0;
      txVisibleReadyPrev <= 1'h0;
    end
    else begin
      automatic logic _GEN_1 = _rx_io_valid & rxIntEnable | rxIrq;
      automatic logic _GEN_2 = io_busStrobe & hitRbuf & io_busRead;
      automatic logic _GEN_3 = _GEN_2 | _GEN & hitRcsr & ~(io_busWdata[6]);
      rxReady <= ~_GEN_2 & (_rx_io_valid | rxReady);
      if (_rx_io_valid)
        rxData <= _rx_io_data;
      if (_GEN & hitRcsr)
        rxIntEnable <= io_busWdata[6];
      if (_GEN & hitXcsr)
        txIntEnable <= io_busWdata[6];
      rxIrq <= io_irqAck ? ~(rxIrq | _GEN_3) & _GEN_1 : ~_GEN_3 & _GEN_1;
      txIrq <=
        (~io_irqAck | rxIrq) & ~(_GEN & (_GEN_0 | hitXcsr & ~(io_busWdata[6])))
        & (txVisibleReady & ~txVisibleReadyPrev & txIntEnable | txIrq);
      txVisibleReadyPrev <= txVisibleReady;
    end
  end // always @(posedge)
  UartRx rx (
    .clock    (clock),
    .reset    (reset),
    .io_rx    (io_uartRx),
    .io_data  (_rx_io_data),
    .io_valid (_rx_io_valid)
  );
  Queue64_UInt8 txQueue (
    .clock        (clock),
    .reset        (reset),
    .io_enq_ready (_txQueue_io_enq_ready),
    .io_enq_valid (_GEN & _GEN_0),
    .io_enq_bits  (io_busWdata[7:0]),
    .io_deq_ready (io_txReady),
    .io_deq_valid (_txQueue_io_deq_valid),
    .io_deq_bits  (io_txData)
  );
  assign io_busHit = hit;
  assign io_busRdata =
    hitRcsr
      ? {8'h0, rxReady, rxIntEnable, 6'h0}
      : hitRbuf
          ? {8'h0, rxData}
          : hitXcsr ? {8'h0, txVisibleReady, txIntEnable, 6'h0} : 16'h0;
  assign io_irq = rxIrq | txIrq;
  assign io_irqVector = rxIrq ? 16'h30 : txIrq ? 16'h34 : 16'h0;
  assign io_txStart = _txQueue_io_deq_valid & io_txReady;
endmodule

