// Generated by CIRCT firtool-1.149.0
module Aw21024Panel(
  input         clk,
                reset_n,
  input  [21:0] addr_value,
  input  [15:0] data_value,
  output        i2c_scl_drive_low,
                i2c_sda_drive_low,
                addr_en,
                data_en
);

  wire        _writer_io_busy;
  wire        _writer_io_done;
  reg  [2:0]  state;
  reg  [3:0]  initIndex;
  reg  [2:0]  refreshIndex;
  reg  [16:0] delayCount;
  reg  [19:0] sampleCount;
  reg  [22:0] holdCount;
  reg  [21:0] displayedAddr;
  reg  [15:0] displayedData;
  reg  [21:0] sampledAddr;
  reg  [15:0] sampledData;
  reg  [21:0] refreshAddr;
  reg  [15:0] refreshData;
  reg         displayValid;
  reg         inRefresh;
  wire        _GEN = initIndex == 4'h1;
  wire        _GEN_0 = initIndex == 4'h0 | _GEN;
  wire        _GEN_1 = initIndex == 4'h2 | initIndex == 4'h3;
  wire        _GEN_2 = initIndex == 4'h4 | initIndex == 4'h5;
  wire        _GEN_3 = initIndex == 4'h6;
  wire        _GEN_4 = initIndex == 4'h7;
  wire        _GEN_5 = initIndex == 4'h8;
  wire        _GEN_6 = initIndex == 4'h9;
  wire [6:0]  _GEN_7 =
    _GEN_0 | _GEN_1 | _GEN_2
      ? {6'h18, initIndex[0]}
      : _GEN_3 | _GEN_4 ? 7'h30 : {6'h18, _GEN_5 | _GEN_6};
  wire [7:0]  _GEN_8 =
    _GEN_0
      ? 8'h0
      : _GEN_1
          ? 8'h6E
          : _GEN_2
              ? 8'h4A
              : _GEN_3 ? 8'h1 : _GEN_4 ? 8'h49 : _GEN_5 ? 8'h1 : _GEN_6 ? 8'h49 : 8'h0;
  wire        _GEN_9 = _GEN_2 | _GEN_3 | ~(_GEN_4 | ~_GEN_5);
  wire        _GEN_10 = _GEN_0 | _GEN_1;
  wire [2:0]  _GEN_11 =
    _GEN_0
      ? 3'h0
      : _GEN_1 ? 3'h1 : _GEN_2 ? 3'h2 : _GEN_3 ? 3'h3 : _GEN_4 ? 3'h5 : {2'h2, ~_GEN_5};
  wire        _GEN_12 = refreshIndex == 3'h0;
  wire        _GEN_13 = refreshIndex == 3'h1;
  wire        _GEN_14 = refreshIndex == 3'h2;
  wire        _GEN_15 = refreshIndex == 3'h3;
  wire        _GEN_16 = state == 3'h0;
  wire        _GEN_17 = state == 3'h1;
  always @(posedge clk) begin
    if (~reset_n) begin
      state <= 3'h0;
      initIndex <= 4'h0;
      refreshIndex <= 3'h0;
      delayCount <= 17'h0;
      sampleCount <= 20'h0;
      holdCount <= 23'h4C4B40;
      displayedAddr <= 22'h0;
      displayedData <= 16'h0;
      sampledAddr <= 22'h0;
      sampledData <= 16'h0;
      refreshAddr <= 22'h0;
      refreshData <= 16'h0;
      displayValid <= 1'h0;
      inRefresh <= 1'h0;
    end
    else begin
      automatic logic        _GEN_18 = sampleCount == 20'hF423F;
      automatic logic [22:0] _holdCount_T;
      automatic logic        _GEN_19;
      automatic logic        _GEN_20;
      automatic logic        _GEN_21 = _GEN_16 | _GEN_17;
      automatic logic        _GEN_22;
      automatic logic        _GEN_23;
      automatic logic        _GEN_24;
      _holdCount_T = holdCount + 23'h1;
      _GEN_19 = holdCount == 23'h4C4B40;
      _GEN_20 = state == 3'h2;
      _GEN_22 = _GEN_21 | ~(_GEN_20 & _writer_io_done);
      _GEN_23 = state == 3'h3;
      _GEN_24 =
        state == 3'h4
        & (~displayValid | sampledAddr != displayedAddr | sampledData != displayedData)
        & _GEN_19 & ~_writer_io_busy;
      if (_GEN_16) begin
        automatic logic _GEN_25 = delayCount == 17'h1869F;
        if (_GEN_25) begin
          state <= 3'h1;
          initIndex <= 4'h0;
        end
        delayCount <= _GEN_25 ? 17'h0 : delayCount + 17'h1;
        inRefresh <= ~_GEN_25 & inRefresh;
      end
      else if (_GEN_17) begin
        if (_writer_io_busy) begin
        end
        else
          state <= 3'h2;
      end
      else begin
        if (_GEN_20) begin
          if (_writer_io_done)
            state <=
              inRefresh ? (_GEN_15 ? 3'h4 : 3'h1) : _GEN ? 3'h3 : _GEN_6 ? 3'h4 : 3'h1;
          if (~_writer_io_done | inRefresh | _GEN | _GEN_6) begin
          end
          else
            initIndex <= initIndex + 4'h1;
          if (~_writer_io_done | inRefresh | ~_GEN) begin
          end
          else
            delayCount <= 17'h0;
        end
        else begin
          automatic logic _GEN_26;
          _GEN_26 = delayCount == 17'h270F;
          if (_GEN_23 ? _GEN_26 : _GEN_24)
            state <= 3'h1;
          if (_GEN_23 & _GEN_26)
            initIndex <= 4'h2;
          if (_GEN_23)
            delayCount <= _GEN_26 ? 17'h0 : delayCount + 17'h1;
        end
        inRefresh <=
          _GEN_20
            ? ~(_writer_io_done & inRefresh & _GEN_15) & inRefresh
            : ~_GEN_23 & _GEN_24 | inRefresh;
      end
      if (~_GEN_21) begin
        if (_GEN_20) begin
          if (~(_writer_io_done & inRefresh) | _GEN_15) begin
          end
          else
            refreshIndex <= refreshIndex + 3'h1;
        end
        else if (_GEN_23 | ~_GEN_24) begin
        end
        else
          refreshIndex <= 3'h0;
      end
      sampleCount <= _GEN_18 ? 20'h0 : sampleCount + 20'h1;
      if (_GEN_22) begin
        if (~_GEN_19)
          holdCount <= _holdCount_T;
      end
      else if (inRefresh) begin
        if (_GEN_15) begin
          holdCount <= 23'h0;
          displayedAddr <= refreshAddr;
          displayedData <= refreshData;
        end
        else if (~_GEN_19)
          holdCount <= _holdCount_T;
      end
      else if (_GEN | ~_GEN_6) begin
        if (~_GEN_19)
          holdCount <= _holdCount_T;
      end
      else begin
        holdCount <= 23'h0;
        displayedAddr <= refreshAddr;
        displayedData <= refreshData;
      end
      if (_GEN_18) begin
        sampledAddr <= addr_value;
        sampledData <= data_value;
      end
      if (_GEN_16 | _GEN_17 | _GEN_20 | _GEN_23 | ~_GEN_24) begin
      end
      else begin
        refreshAddr <= sampledAddr;
        refreshData <= sampledData;
      end
      if (_GEN_22) begin
      end
      else
        displayValid <=
          inRefresh ? _GEN_15 | displayValid : ~_GEN & _GEN_6 | displayValid;
    end
  end // always @(posedge)
  Aw21024I2cBurstWriter writer (
    .clock          (clk),
    .reset          (~reset_n),
    .io_start       (~_GEN_16 & _GEN_17 & ~_writer_io_busy),
    .io_devAddr
      (inRefresh
         ? (_GEN_12 | _GEN_13 ? 7'h30 : _GEN_14 | _GEN_15 ? 7'h31 : _GEN_7)
         : _GEN_7),
    .io_regAddr
      (inRefresh
         ? (_GEN_12 ? 8'h1 : _GEN_13 ? 8'h49 : _GEN_14 ? 8'h1 : _GEN_15 ? 8'h49 : _GEN_8)
         : _GEN_8),
    .io_length
      (inRefresh
         ? (_GEN_12 | ~(_GEN_13 | ~(_GEN_14 | ~(_GEN_15 | _GEN_10 | ~_GEN_9)))
              ? 5'h18
              : 5'h1)
         : _GEN_10 | ~_GEN_9 ? 5'h1 : 5'h18),
    .io_kind
      (inRefresh
         ? (_GEN_12 ? 3'h3 : _GEN_13 ? 3'h5 : _GEN_14 ? 3'h4 : _GEN_15 ? 3'h5 : _GEN_11)
         : _GEN_11),
    .io_addrValue   (refreshAddr),
    .io_dataValue   (refreshData),
    .io_sclDriveLow (i2c_scl_drive_low),
    .io_sdaDriveLow (i2c_sda_drive_low),
    .io_busy        (_writer_io_busy),
    .io_done        (_writer_io_done)
  );
  assign addr_en = |state;
  assign data_en = |state;
endmodule

