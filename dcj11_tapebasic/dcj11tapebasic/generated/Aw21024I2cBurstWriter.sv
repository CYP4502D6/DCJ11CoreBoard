// Generated by CIRCT firtool-1.149.0
module Aw21024I2cBurstWriter(
  input         clock,
                reset,
                io_start,
  input  [6:0]  io_devAddr,
  input  [7:0]  io_regAddr,
  input  [4:0]  io_length,
  input  [2:0]  io_kind,
  input  [21:0] io_addrValue,
  input  [15:0] io_dataValue,
  output        io_sclDriveLow,
                io_sdaDriveLow,
                io_busy,
                io_done
);

  reg [3:0]  state;
  reg [7:0]  tickCount;
  reg        sclDriveLowReg;
  reg        sdaDriveLowReg;
  reg [6:0]  devAddrReg;
  reg [7:0]  regAddrReg;
  reg [4:0]  lengthReg;
  reg [2:0]  kindReg;
  reg [21:0] addrValueReg;
  reg [15:0] dataValueReg;
  reg [7:0]  currentByte;
  reg [5:0]  byteIndex;
  reg [2:0]  bitIndex;
  reg        doneReg;
  always @(posedge clock) begin
    if (reset) begin
      state <= 4'h0;
      tickCount <= 8'h0;
      sclDriveLowReg <= 1'h0;
      sdaDriveLowReg <= 1'h0;
      devAddrReg <= 7'h0;
      regAddrReg <= 8'h0;
      lengthReg <= 5'h1;
      kindReg <= 3'h5;
      addrValueReg <= 22'h0;
      dataValueReg <= 16'h0;
      currentByte <= 8'h0;
      byteIndex <= 6'h0;
      bitIndex <= 3'h7;
      doneReg <= 1'h0;
    end
    else begin
      automatic logic       _GEN = state == 4'h0;
      automatic logic       _GEN_0;
      automatic logic       _GEN_1;
      automatic logic       _GEN_2;
      automatic logic       _GEN_3;
      automatic logic       _GEN_4;
      automatic logic       _GEN_5;
      automatic logic       _GEN_6;
      automatic logic       _GEN_7;
      automatic logic       _GEN_8;
      automatic logic       _GEN_9;
      automatic logic       _GEN_10;
      automatic logic       _GEN_11;
      automatic logic       _GEN_12;
      automatic logic       _GEN_13;
      automatic logic       _GEN_14 = state == 4'hB;
      automatic logic       _GEN_15 = state == 4'hC;
      automatic logic       _GEN_16 = state == 4'hD;
      automatic logic       _GEN_17 = _GEN_14 | _GEN_15;
      automatic logic [7:0] _sdaDriveLowReg_T = currentByte >> bitIndex;
      _GEN_0 = tickCount == 8'hF9;
      _GEN_1 = state == 4'h1;
      _GEN_2 = state == 4'h2;
      _GEN_3 = state == 4'h3;
      _GEN_4 = state == 4'h4;
      _GEN_5 = _GEN_2 | _GEN_3;
      _GEN_6 = _GEN_1 | _GEN_5;
      _GEN_7 = state == 4'h5;
      _GEN_8 = state == 4'h6;
      _GEN_9 = state == 4'h7;
      _GEN_10 = state == 4'h8;
      _GEN_11 = state == 4'h9;
      _GEN_12 = state == 4'hA;
      _GEN_13 = byteIndex == {1'h0, lengthReg + 5'h1};
      if (_GEN) begin
        if (io_start) begin
          state <= 4'h1;
          byteIndex <= 6'h0;
          bitIndex <= 3'h7;
        end
      end
      else begin
        automatic logic _GEN_18;
        _GEN_18 = bitIndex == 3'h0;
        if (_GEN_0) begin
          automatic logic [15:0][3:0] _GEN_19;
          _GEN_19 =
            {{state},
             {state},
             {4'h0},
             {4'hD},
             {4'hC},
             {_GEN_13 ? 4'hB : 4'h4},
             {4'hA},
             {4'h9},
             {_GEN_18 ? 4'h8 : 4'h5},
             {4'h7},
             {4'h6},
             {4'h5},
             {4'h4},
             {4'h3},
             {4'h2},
             {state}};
          state <= _GEN_19[state];
        end
        if (~_GEN_0 | _GEN_1 | _GEN_2 | _GEN_3 | _GEN_4 | _GEN_7 | _GEN_8 | _GEN_9
            | _GEN_10 | _GEN_11 | ~_GEN_12 | _GEN_13) begin
        end
        else
          byteIndex <= byteIndex + 6'h1;
        if (~_GEN_0 | _GEN_6) begin
        end
        else if (_GEN_4)
          bitIndex <= 3'h7;
        else if (_GEN_7 | _GEN_8 | ~_GEN_9 | _GEN_18) begin
        end
        else
          bitIndex <= bitIndex - 3'h1;
      end
      tickCount <= _GEN | _GEN_0 ? 8'h0 : tickCount + 8'h1;
      sclDriveLowReg <=
        ~_GEN
        & (_GEN_0
             ? ~(_GEN_1 | _GEN_2)
               & (_GEN_3 | _GEN_4 | _GEN_7 | ~_GEN_8
                  & (_GEN_9 | _GEN_10 | ~_GEN_11
                     & (_GEN_12 | _GEN_14 | ~(_GEN_15 | _GEN_16) & sclDriveLowReg)))
             : sclDriveLowReg);
      sdaDriveLowReg <=
        ~_GEN
        & (_GEN_0
             ? ~_GEN_1
               & (_GEN_5
                  | (_GEN_4
                       ? sdaDriveLowReg
                       : _GEN_7
                           ? ~(_sdaDriveLowReg_T[0])
                           : _GEN_8 | _GEN_9
                               ? sdaDriveLowReg
                               : ~_GEN_10
                                 & (_GEN_11
                                      ? sdaDriveLowReg
                                      : _GEN_12
                                          ? _GEN_13 | sdaDriveLowReg
                                          : _GEN_17 | ~_GEN_16 & sdaDriveLowReg)))
             : sdaDriveLowReg);
      if (_GEN & io_start) begin
        devAddrReg <= io_devAddr;
        regAddrReg <= io_regAddr;
        lengthReg <= io_length;
        kindReg <= io_kind;
        addrValueReg <= io_addrValue;
        dataValueReg <= io_dataValue;
      end
      if (_GEN | ~_GEN_0 | _GEN_6 | ~_GEN_4) begin
      end
      else begin
        automatic logic [5:0]      _dataIndex_T = byteIndex - 6'h2;
        automatic logic [7:0]      _selectedByte_T_3 = {7'h0, kindReg == 3'h0};
        automatic logic [15:0]     _selectedByte_dataOn_T_1 =
          dataValueReg >> _dataIndex_T;
        automatic logic [21:0]     _selectedByte_addrOn_T_1 =
          addrValueReg >> _dataIndex_T;
        automatic logic [7:0][7:0] _GEN_20 =
          {{_selectedByte_T_3},
           {_selectedByte_T_3},
           {8'h0},
           {{2'h0, _dataIndex_T < 6'h10 & _selectedByte_dataOn_T_1[0], 5'h0}},
           {{2'h0, _dataIndex_T < 6'h16 & _selectedByte_addrOn_T_1[0], 5'h0}},
           {8'hFF},
           {8'h40},
           {_selectedByte_T_3}};
        currentByte <=
          byteIndex == 6'h0
            ? {devAddrReg, 1'h0}
            : byteIndex == 6'h1 ? regAddrReg : _GEN_20[kindReg];
      end
      doneReg <=
        ~_GEN & _GEN_0
        & ~(_GEN_1 | _GEN_2 | _GEN_3 | _GEN_4 | _GEN_7 | _GEN_8 | _GEN_9 | _GEN_10
            | _GEN_11 | _GEN_12 | _GEN_17) & _GEN_16;
    end
  end // always @(posedge)
  assign io_sclDriveLow = sclDriveLowReg;
  assign io_sdaDriveLow = sdaDriveLowReg;
  assign io_busy = |state;
  assign io_done = doneReg;
endmodule

