// Generated by CIRCT firtool-1.149.0
module Kw11(
  input         clock,
                reset,
  input  [21:0] io_bus_address,
                io_bus_writeAddress,
  input         io_bus_writePulse,
  input  [15:0] io_bus_dataIn,
  input  [1:0]  io_bus_byteEnable,
  output        io_bus_hit,
  output [15:0] io_bus_dataOut,
  output        io_eventN,
  input         io_acknowledge
);

  reg  [19:0] counter;
  reg         done;
  reg         ie;
  wire        tick;
  wire        write;
  assign tick = counter == 20'hCB734;
  assign write =
    io_bus_writePulse & io_bus_writeAddress == 22'h3FFF66 & io_bus_byteEnable[0];
  always @(posedge clock) begin
    if (reset) begin
      counter <= 20'h0;
      done <= 1'h1;
      ie <= 1'h0;
    end
    else begin
      counter <= tick ? 20'h0 : counter + 20'h1;
      done <= ~(io_acknowledge | write) & (tick | done);
      if (io_acknowledge | ~write) begin
      end
      else
        ie <= io_bus_dataIn[6];
    end
  end // always @(posedge)
  assign io_bus_hit = io_bus_address == 22'h3FFF66;
  assign io_bus_dataOut = {8'h0, done, ie, 6'h0};
  assign io_eventN = ~(done & ie);
endmodule

