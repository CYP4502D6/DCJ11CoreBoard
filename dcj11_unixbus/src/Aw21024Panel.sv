// Generated by CIRCT firtool-1.149.0
module Aw21024Panel(
  input         clock,
                reset,
  input  [21:0] io_addressValue,
  input  [15:0] io_dataValue,
  output        io_sclDriveLow,
                io_sdaDriveLow,
                io_addressEnable,
                io_dataEnable
);

  wire        _writer_io_busy;
  wire        _writer_io_done;
  reg  [2:0]  state;
  reg  [3:0]  initIndex;
  reg  [2:0]  refreshIndex;
  reg  [16:0] delayCount;
  reg  [17:0] sampleCount;
  reg  [21:0] holdCount;
  reg  [21:0] displayedAddress;
  reg  [15:0] displayedData;
  reg  [21:0] sampledAddress;
  reg  [15:0] sampledData;
  reg  [21:0] refreshAddress;
  reg  [15:0] refreshData;
  reg         displayValid;
  reg         refreshing;
  wire        _GEN;
  wire        _GEN_0;
  wire        _GEN_1;
  wire        _GEN_2;
  wire        _GEN_3;
  wire        _GEN_4;
  wire        _GEN_5;
  wire        _GEN_6;
  wire [4:0]  _GEN_7;
  wire [2:0]  _GEN_8;
  wire        _GEN_9;
  wire [6:0]  _GEN_10;
  wire [7:0]  _GEN_11;
  wire        _GEN_12;
  wire        _GEN_13;
  wire        _GEN_14;
  wire        _GEN_15;
  wire        _GEN_16;
  wire        _GEN_17;
  wire        _GEN_18;
  wire        _GEN_19;
  wire        _GEN_20;
  wire [21:0] _holdCount_T;
  wire        _GEN_21;
  wire        _GEN_22;
  wire        _GEN_23;
  wire        _GEN_24;
  wire        _GEN_25;
  wire        _GEN_26;
  assign _GEN = initIndex == 4'h1;
  assign _GEN_0 = initIndex == 4'h0 | _GEN;
  assign _GEN_1 = initIndex == 4'h2 | initIndex == 4'h3;
  assign _GEN_2 = initIndex == 4'h4 | initIndex == 4'h5;
  assign _GEN_3 = initIndex == 4'h6;
  assign _GEN_4 = initIndex == 4'h7;
  assign _GEN_5 = initIndex == 4'h8;
  assign _GEN_6 = _GEN_0 | _GEN_1 | ~(_GEN_2 | _GEN_3 | ~(_GEN_4 | ~_GEN_5));
  assign _GEN_7 = _GEN_6 ? 5'h1 : 5'h18;
  assign _GEN_8 =
    _GEN_0
      ? 3'h0
      : _GEN_1 ? 3'h1 : _GEN_2 ? 3'h2 : _GEN_3 ? 3'h3 : _GEN_4 ? 3'h5 : {2'h2, ~_GEN_5};
  assign _GEN_9 = initIndex == 4'h9;
  assign _GEN_10 =
    _GEN_0 | _GEN_1 | _GEN_2
      ? {6'h18, initIndex[0]}
      : _GEN_3 | _GEN_4 ? 7'h30 : {6'h18, _GEN_5 | _GEN_9};
  assign _GEN_11 =
    _GEN_0
      ? 8'h0
      : _GEN_1
          ? 8'h6E
          : _GEN_2
              ? 8'h4A
              : _GEN_3 ? 8'h1 : _GEN_4 ? 8'h49 : _GEN_5 ? 8'h1 : _GEN_9 ? 8'h49 : 8'h0;
  assign _GEN_12 = refreshIndex == 3'h0;
  assign _GEN_13 = refreshIndex == 3'h1;
  assign _GEN_14 = refreshIndex == 3'h2;
  assign _GEN_15 = refreshIndex == 3'h3;
  assign _GEN_16 = state == 3'h0;
  assign _GEN_17 = state == 3'h1;
  assign _GEN_18 = delayCount == 17'h1869F;
  assign _GEN_19 = delayCount == 17'h270F;
  assign _GEN_20 = sampleCount == 18'h3D08F;
  assign _holdCount_T = holdCount + 22'h1;
  assign _GEN_21 = holdCount == 22'h2625A0;
  assign _GEN_22 = state == 3'h2;
  assign _GEN_23 = _GEN_16 | _GEN_17;
  assign _GEN_24 = _GEN_23 | ~(_GEN_22 & _writer_io_done);
  assign _GEN_25 = state == 3'h3;
  assign _GEN_26 =
    state == 3'h4
    & (~displayValid | sampledAddress != displayedAddress | sampledData != displayedData)
    & _GEN_21 & ~_writer_io_busy;
  always @(posedge clock) begin
    if (reset) begin
      state <= 3'h0;
      initIndex <= 4'h0;
      refreshIndex <= 3'h0;
      delayCount <= 17'h0;
      sampleCount <= 18'h0;
      holdCount <= 22'h2625A0;
      displayedAddress <= 22'h0;
      displayedData <= 16'h0;
      sampledAddress <= 22'h0;
      sampledData <= 16'h0;
      refreshAddress <= 22'h0;
      refreshData <= 16'h0;
      displayValid <= 1'h0;
      refreshing <= 1'h0;
    end
    else begin
      if (_GEN_16) begin
        if (_GEN_18) begin
          state <= 3'h1;
          initIndex <= 4'h0;
        end
        delayCount <= _GEN_18 ? 17'h0 : delayCount + 17'h1;
        refreshing <= ~_GEN_18 & refreshing;
      end
      else if (_GEN_17) begin
        if (_writer_io_busy) begin
        end
        else
          state <= 3'h2;
      end
      else begin
        if (_GEN_22) begin
          if (_writer_io_done)
            state <=
              refreshing ? (_GEN_15 ? 3'h4 : 3'h1) : _GEN ? 3'h3 : _GEN_9 ? 3'h4 : 3'h1;
          if (~_writer_io_done | refreshing | _GEN | _GEN_9) begin
          end
          else
            initIndex <= initIndex + 4'h1;
          if (~_writer_io_done | refreshing | ~_GEN) begin
          end
          else
            delayCount <= 17'h0;
        end
        else begin
          if (_GEN_25 ? _GEN_19 : _GEN_26)
            state <= 3'h1;
          if (_GEN_25 & _GEN_19)
            initIndex <= 4'h2;
          if (_GEN_25)
            delayCount <= _GEN_19 ? 17'h0 : delayCount + 17'h1;
        end
        refreshing <=
          _GEN_22
            ? ~(_writer_io_done & refreshing & _GEN_15) & refreshing
            : ~_GEN_25 & _GEN_26 | refreshing;
      end
      if (~_GEN_23) begin
        if (_GEN_22) begin
          if (~(_writer_io_done & refreshing) | _GEN_15) begin
          end
          else
            refreshIndex <= refreshIndex + 3'h1;
        end
        else if (_GEN_25 | ~_GEN_26) begin
        end
        else
          refreshIndex <= 3'h0;
      end
      sampleCount <= _GEN_20 ? 18'h0 : sampleCount + 18'h1;
      if (_GEN_24) begin
        if (~_GEN_21)
          holdCount <= _holdCount_T;
      end
      else if (refreshing) begin
        if (_GEN_15) begin
          holdCount <= 22'h0;
          displayedAddress <= refreshAddress;
          displayedData <= refreshData;
        end
        else if (~_GEN_21)
          holdCount <= _holdCount_T;
      end
      else if (_GEN | ~_GEN_9) begin
        if (~_GEN_21)
          holdCount <= _holdCount_T;
      end
      else begin
        holdCount <= 22'h0;
        displayedAddress <= refreshAddress;
        displayedData <= refreshData;
      end
      if (_GEN_20) begin
        sampledAddress <= io_addressValue;
        sampledData <= io_dataValue;
      end
      if (_GEN_16 | _GEN_17 | _GEN_22 | _GEN_25 | ~_GEN_26) begin
      end
      else begin
        refreshAddress <= sampledAddress;
        refreshData <= sampledData;
      end
      if (_GEN_24) begin
      end
      else
        displayValid <=
          refreshing ? _GEN_15 | displayValid : ~_GEN & _GEN_9 | displayValid;
    end
  end // always @(posedge)
  Aw21024I2cBurstWriter writer (
    .clock              (clock),
    .reset              (reset),
    .io_start           (~_GEN_16 & _GEN_17 & ~_writer_io_busy),
    .io_deviceAddress
      (refreshing
         ? (_GEN_12 | _GEN_13 ? 7'h30 : _GEN_14 | _GEN_15 ? 7'h31 : _GEN_10)
         : _GEN_10),
    .io_registerAddress
      (refreshing
         ? (_GEN_12 ? 8'h1 : _GEN_13 ? 8'h49 : _GEN_14 ? 8'h1 : _GEN_15 ? 8'h49 : _GEN_11)
         : _GEN_11),
    .io_length
      (refreshing
         ? (_GEN_12 ? 5'h18 : _GEN_13 ? _GEN_7 : _GEN_14 | ~_GEN_6 ? 5'h18 : 5'h1)
         : _GEN_7),
    .io_kind
      (refreshing ? (_GEN_12 ? 3'h3 : _GEN_13 | ~_GEN_14 ? _GEN_8 : 3'h4) : _GEN_8),
    .io_addressValue    (refreshAddress),
    .io_dataValue       (refreshData),
    .io_sclDriveLow     (io_sclDriveLow),
    .io_sdaDriveLow     (io_sdaDriveLow),
    .io_busy            (_writer_io_busy),
    .io_done            (_writer_io_done)
  );
  assign io_addressEnable = |state;
  assign io_dataEnable = |state;
endmodule

