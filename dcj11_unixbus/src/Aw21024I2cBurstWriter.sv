// Generated by CIRCT firtool-1.149.0
module Aw21024I2cBurstWriter(
  input         clock,
                reset,
                io_start,
  input  [6:0]  io_deviceAddress,
  input  [7:0]  io_registerAddress,
  input  [4:0]  io_length,
  input  [2:0]  io_kind,
  input  [21:0] io_addressValue,
  input  [15:0] io_dataValue,
  output        io_sclDriveLow,
                io_sdaDriveLow,
                io_busy,
                io_done
);

  reg  [3:0]  state;
  reg  [7:0]  tickCount;
  reg         sclDriveLow;
  reg         sdaDriveLow;
  reg  [6:0]  deviceAddress;
  reg  [7:0]  registerAddress;
  reg  [4:0]  length;
  reg  [2:0]  kind;
  reg  [21:0] addressValue;
  reg  [15:0] dataValue;
  reg  [7:0]  currentByte;
  reg  [5:0]  byteIndex;
  reg  [2:0]  bitIndex;
  reg         done;
  reg  [7:0]  casez_tmp;
  wire [5:0]  _dataIndex_T;
  wire [7:0]  _selectedByte_T_3;
  wire [21:0] _selectedByte_addressOn_T_1;
  wire [15:0] _selectedByte_dataOn_T_1;
  wire        _GEN;
  wire        _GEN_0;
  reg  [3:0]  casez_tmp_0;
  wire        _GEN_1;
  wire        _GEN_2;
  wire        _GEN_3;
  wire        _GEN_4;
  wire        _GEN_5;
  wire        _GEN_6;
  wire        _GEN_7;
  wire        _GEN_8;
  wire        _GEN_9;
  wire        _GEN_10;
  wire        _GEN_11;
  wire        _GEN_12;
  wire        _GEN_13;
  wire        _GEN_14;
  wire        _GEN_15;
  wire        _GEN_16;
  wire        _GEN_17;
  wire        _GEN_18;
  wire [7:0]  _sdaDriveLow_T;
  assign _dataIndex_T = byteIndex - 6'h2;
  assign _selectedByte_T_3 = {7'h0, kind == 3'h0};
  assign _selectedByte_addressOn_T_1 = addressValue >> _dataIndex_T;
  assign _selectedByte_dataOn_T_1 = dataValue >> _dataIndex_T;
  always_comb begin
    casez (kind)
      3'b000:
        casez_tmp = _selectedByte_T_3;
      3'b001:
        casez_tmp = 8'h40;
      3'b010:
        casez_tmp = 8'hFF;
      3'b011:
        casez_tmp = {2'h0, _dataIndex_T < 6'h16 & _selectedByte_addressOn_T_1[0], 5'h0};
      3'b100:
        casez_tmp = {2'h0, _dataIndex_T < 6'h10 & _selectedByte_dataOn_T_1[0], 5'h0};
      3'b101:
        casez_tmp = 8'h0;
      3'b110:
        casez_tmp = _selectedByte_T_3;
      default:
        casez_tmp = _selectedByte_T_3;
    endcase
  end // always_comb
  assign _GEN = bitIndex == 3'h0;
  assign _GEN_0 = byteIndex == {1'h0, length + 5'h1};
  always_comb begin
    casez (state)
      4'b0000:
        casez_tmp_0 = state;
      4'b0001:
        casez_tmp_0 = 4'h2;
      4'b0010:
        casez_tmp_0 = 4'h3;
      4'b0011:
        casez_tmp_0 = 4'h4;
      4'b0100:
        casez_tmp_0 = 4'h5;
      4'b0101:
        casez_tmp_0 = 4'h6;
      4'b0110:
        casez_tmp_0 = 4'h7;
      4'b0111:
        casez_tmp_0 = _GEN ? 4'h8 : 4'h5;
      4'b1000:
        casez_tmp_0 = 4'h9;
      4'b1001:
        casez_tmp_0 = 4'hA;
      4'b1010:
        casez_tmp_0 = _GEN_0 ? 4'hB : 4'h4;
      4'b1011:
        casez_tmp_0 = 4'hC;
      4'b1100:
        casez_tmp_0 = 4'hD;
      4'b1101:
        casez_tmp_0 = 4'h0;
      4'b1110:
        casez_tmp_0 = state;
      default:
        casez_tmp_0 = state;
    endcase
  end // always_comb
  assign _GEN_1 = state == 4'h0;
  assign _GEN_2 = tickCount == 8'hF9;
  assign _GEN_3 = state == 4'h1;
  assign _GEN_4 = state == 4'h2;
  assign _GEN_5 = state == 4'h3;
  assign _GEN_6 = state == 4'h4;
  assign _GEN_7 = _GEN_4 | _GEN_5;
  assign _GEN_8 = _GEN_3 | _GEN_7;
  assign _GEN_9 = state == 4'h5;
  assign _GEN_10 = state == 4'h6;
  assign _GEN_11 = state == 4'h7;
  assign _GEN_12 = state == 4'h8;
  assign _GEN_13 = state == 4'h9;
  assign _GEN_14 = state == 4'hA;
  assign _GEN_15 = state == 4'hB;
  assign _GEN_16 = state == 4'hC;
  assign _GEN_17 = state == 4'hD;
  assign _GEN_18 = _GEN_15 | _GEN_16;
  assign _sdaDriveLow_T = currentByte >> bitIndex;
  always @(posedge clock) begin
    if (reset) begin
      state <= 4'h0;
      tickCount <= 8'h0;
      sclDriveLow <= 1'h0;
      sdaDriveLow <= 1'h0;
      deviceAddress <= 7'h0;
      registerAddress <= 8'h0;
      length <= 5'h1;
      kind <= 3'h5;
      addressValue <= 22'h0;
      dataValue <= 16'h0;
      currentByte <= 8'h0;
      byteIndex <= 6'h0;
      bitIndex <= 3'h7;
      done <= 1'h0;
    end
    else begin
      if (_GEN_1) begin
        if (io_start) begin
          state <= 4'h1;
          byteIndex <= 6'h0;
          bitIndex <= 3'h7;
        end
      end
      else begin
        if (_GEN_2)
          state <= casez_tmp_0;
        if (~_GEN_2 | _GEN_3 | _GEN_4 | _GEN_5 | _GEN_6 | _GEN_9 | _GEN_10 | _GEN_11
            | _GEN_12 | _GEN_13 | ~_GEN_14 | _GEN_0) begin
        end
        else
          byteIndex <= byteIndex + 6'h1;
        if (~_GEN_2 | _GEN_8) begin
        end
        else if (_GEN_6)
          bitIndex <= 3'h7;
        else if (_GEN_9 | _GEN_10 | ~_GEN_11 | _GEN) begin
        end
        else
          bitIndex <= bitIndex - 3'h1;
      end
      tickCount <= _GEN_1 | _GEN_2 ? 8'h0 : tickCount + 8'h1;
      sclDriveLow <=
        ~_GEN_1
        & (_GEN_2
             ? ~(_GEN_3 | _GEN_4)
               & (_GEN_5 | _GEN_6 | _GEN_9 | ~_GEN_10
                  & (_GEN_11 | _GEN_12 | ~_GEN_13
                     & (_GEN_14 | _GEN_15 | ~(_GEN_16 | _GEN_17) & sclDriveLow)))
             : sclDriveLow);
      sdaDriveLow <=
        ~_GEN_1
        & (_GEN_2
             ? ~_GEN_3
               & (_GEN_7
                  | (_GEN_6
                       ? sdaDriveLow
                       : _GEN_9
                           ? ~(_sdaDriveLow_T[0])
                           : _GEN_10 | _GEN_11
                               ? sdaDriveLow
                               : ~_GEN_12
                                 & (_GEN_13
                                      ? sdaDriveLow
                                      : _GEN_14
                                          ? _GEN_0 | sdaDriveLow
                                          : _GEN_18 | ~_GEN_17 & sdaDriveLow)))
             : sdaDriveLow);
      if (_GEN_1 & io_start) begin
        deviceAddress <= io_deviceAddress;
        registerAddress <= io_registerAddress;
        length <= io_length;
        kind <= io_kind;
        addressValue <= io_addressValue;
        dataValue <= io_dataValue;
      end
      if (_GEN_1 | ~_GEN_2 | _GEN_8 | ~_GEN_6) begin
      end
      else
        currentByte <=
          byteIndex == 6'h0
            ? {deviceAddress, 1'h0}
            : byteIndex == 6'h1 ? registerAddress : casez_tmp;
      done <=
        ~_GEN_1 & _GEN_2
        & ~(_GEN_3 | _GEN_4 | _GEN_5 | _GEN_6 | _GEN_9 | _GEN_10 | _GEN_11 | _GEN_12
            | _GEN_13 | _GEN_14 | _GEN_18) & _GEN_17;
    end
  end // always @(posedge)
  assign io_sclDriveLow = sclDriveLow;
  assign io_sdaDriveLow = sdaDriveLow;
  assign io_busy = |state;
  assign io_done = done;
endmodule

