// Generated by CIRCT firtool-1.149.0
module UartRx(
  input        clock,
               reset,
               io_rx,
  output [7:0] io_data,
  output       io_valid
);

  reg        meta;
  reg        sync;
  reg  [1:0] state;
  reg  [8:0] timer;
  reg  [2:0] index;
  reg  [7:0] byte_0;
  reg  [8:0] idleHighCount;
  reg        valid;
  wire       _GEN;
  wire       _GEN_0;
  wire       _GEN_1;
  wire       _GEN_2;
  reg  [1:0] casez_tmp;
  reg  [8:0] casez_tmp_0;
  wire [7:0] _byte_T;
  wire       _GEN_3;
  wire       _GEN_4;
  wire       _GEN_5;
  wire       _GEN_6;
  assign _GEN = idleHighCount == 9'h1B1;
  assign _GEN_0 = ~sync & _GEN;
  assign _GEN_1 = timer == 9'h0;
  assign _GEN_2 = (&state) & _GEN_1;
  always_comb begin
    casez (state)
      2'b00:
        casez_tmp = _GEN_0 ? 2'h1 : state;
      2'b01:
        casez_tmp = _GEN_1 ? {~sync, 1'h0} : state;
      2'b10:
        casez_tmp = _GEN_1 & (&index) ? 2'h3 : state;
      default:
        casez_tmp = _GEN_2 ? 2'h0 : state;
    endcase
  end // always_comb
  always_comb begin
    casez (state)
      2'b00:
        casez_tmp_0 = _GEN_0 ? 9'hD8 : timer;
      2'b01:
        casez_tmp_0 = _GEN_1 ? (sync ? timer : 9'h1B1) : timer - 9'h1;
      2'b10:
        casez_tmp_0 = _GEN_1 ? 9'h1B1 : timer - 9'h1;
      default:
        casez_tmp_0 = ~(&state) | _GEN_1 ? timer : timer - 9'h1;
    endcase
  end // always_comb
  assign _byte_T = 8'h1 << index;
  assign _GEN_3 = state == 2'h0;
  assign _GEN_4 = state == 2'h1;
  assign _GEN_5 = state == 2'h2;
  assign _GEN_6 = _GEN_5 & _GEN_1;
  always @(posedge clock) begin
    if (reset) begin
      meta <= 1'h1;
      sync <= 1'h1;
      state <= 2'h0;
      timer <= 9'h0;
      index <= 3'h0;
      byte_0 <= 8'h0;
      idleHighCount <= 9'h0;
      valid <= 1'h0;
    end
    else begin
      meta <= io_rx;
      sync <= meta;
      state <= casez_tmp;
      timer <= casez_tmp_0;
      if (_GEN_3) begin
        if (_GEN_0)
          byte_0 <= 8'h0;
      end
      else begin
        if (_GEN_4) begin
          if (_GEN_1 & ~sync)
            index <= 3'h0;
        end
        else if (~_GEN_6 | (&index)) begin
        end
        else
          index <= index + 3'h1;
        if (_GEN_4 | ~_GEN_6) begin
        end
        else
          byte_0 <= sync ? byte_0 | _byte_T : ~(~byte_0 | _byte_T);
      end
      if (sync) begin
        if (~_GEN)
          idleHighCount <= idleHighCount + 9'h1;
      end
      else
        idleHighCount <= 9'h0;
      valid <= ~(_GEN_3 | _GEN_4 | _GEN_5) & _GEN_2 & sync;
    end
  end // always @(posedge)
  assign io_data = byte_0;
  assign io_valid = valid;
endmodule

