// Generated by CIRCT firtool-1.149.0
module UartTx(
  input        clock,
               reset,
               io_start,
  input  [7:0] io_data,
  output       io_tx,
               io_ready
);

  reg        busy;
  reg  [8:0] timer;
  reg  [9:0] bits;
  reg  [3:0] index;
  wire       _GEN;
  wire       _GEN_0;
  wire       _GEN_1;
  wire       _GEN_2;
  assign _GEN = io_start & ~busy;
  assign _GEN_0 = timer == 9'h0;
  assign _GEN_1 = index == 4'h9;
  assign _GEN_2 = busy & _GEN_0;
  always @(posedge clock) begin
    if (reset) begin
      busy <= 1'h0;
      timer <= 9'h0;
      bits <= 10'h3FF;
      index <= 4'h0;
    end
    else begin
      busy <= _GEN | ~(busy & _GEN_0 & _GEN_1) & busy;
      if (_GEN) begin
        timer <= 9'h1B1;
        bits <= {1'h1, io_data, 1'h0};
        index <= 4'h0;
      end
      else begin
        if (busy)
          timer <= _GEN_0 ? 9'h1B1 : timer - 9'h1;
        if (_GEN_2)
          bits <= {1'h1, bits[9:1]};
        if (~_GEN_2 | _GEN_1) begin
        end
        else
          index <= index + 4'h1;
      end
    end
  end // always @(posedge)
  assign io_tx = ~busy | bits[0];
  assign io_ready = ~busy;
endmodule

