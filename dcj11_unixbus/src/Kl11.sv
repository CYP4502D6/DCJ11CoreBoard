// Generated by CIRCT firtool-1.149.0
module Kl11(
  input         clock,
                reset,
  input  [21:0] io_bus_address,
                io_bus_readAddress,
                io_bus_writeAddress,
  input         io_bus_readPulse,
                io_bus_writePulse,
  input  [15:0] io_bus_dataIn,
  input  [1:0]  io_bus_byteEnable,
  output        io_bus_hit,
  output [15:0] io_bus_dataOut,
  input         io_uartRx,
  output        io_uartTx,
                io_irq,
  output [15:0] io_vector,
  input         io_acknowledge,
  input  [15:0] io_acknowledgeVector
);

  wire       _tx_io_ready;
  wire [7:0] _rx_io_data;
  wire       _rx_io_valid;
  reg        rxDone;
  reg  [7:0] rxData;
  reg        rxIe;
  reg        txIe;
  reg        rxPending;
  reg        txPending;
  wire       hitRcsr;
  wire       hitRbuf;
  wire       hitXcsr;
  wire       txStart;
  reg        txReadyPrevious;
  wire       _GEN;
  wire       _GEN_0;
  wire       _GEN_1;
  wire       _GEN_2;
  wire       _GEN_3;
  wire       _GEN_4;
  assign hitRcsr = io_bus_address == 22'h3FFF70;
  assign hitRbuf = io_bus_address == 22'h3FFF72;
  assign hitXcsr = io_bus_address == 22'h3FFF74;
  assign txStart =
    io_bus_writePulse & io_bus_writeAddress == 22'h3FFF76 & io_bus_byteEnable[0]
    & _tx_io_ready;
  assign _GEN = io_acknowledgeVector == 16'h30;
  assign _GEN_0 = (~io_acknowledge | _GEN | io_acknowledgeVector != 16'h34) & txPending;
  assign _GEN_1 = _rx_io_valid & rxIe | ~(io_acknowledge & _GEN) & rxPending;
  assign _GEN_2 = io_bus_readPulse & io_bus_readAddress == 22'h3FFF72;
  assign _GEN_3 =
    io_bus_writePulse & io_bus_writeAddress == 22'h3FFF70 & io_bus_byteEnable[0];
  assign _GEN_4 =
    io_bus_writePulse & io_bus_writeAddress == 22'h3FFF74 & io_bus_byteEnable[0];
  always @(posedge clock) begin
    if (reset) begin
      rxDone <= 1'h0;
      rxData <= 8'h0;
      rxIe <= 1'h0;
      txIe <= 1'h0;
      rxPending <= 1'h0;
      txPending <= 1'h0;
      txReadyPrevious <= 1'h1;
    end
    else begin
      rxDone <= ~_GEN_2 & (_rx_io_valid | rxDone);
      if (_rx_io_valid)
        rxData <= _rx_io_data;
      if (_GEN_3)
        rxIe <= io_bus_dataIn[6];
      if (_GEN_4)
        txIe <= io_bus_dataIn[6];
      rxPending <= _GEN_3 ? ~(~(io_bus_dataIn[6]) | _GEN_2) & _GEN_1 : ~_GEN_2 & _GEN_1;
      txPending <=
        _tx_io_ready & ~txReadyPrevious & txIe | ~txStart
        & (_GEN_4 ? io_bus_dataIn[6] & _tx_io_ready | io_bus_dataIn[6] & _GEN_0 : _GEN_0);
      txReadyPrevious <= _tx_io_ready;
    end
  end // always @(posedge)
  UartRx rx (
    .clock    (clock),
    .reset    (reset),
    .io_rx    (io_uartRx),
    .io_data  (_rx_io_data),
    .io_valid (_rx_io_valid)
  );
  UartTx tx (
    .clock    (clock),
    .reset    (reset),
    .io_start (txStart),
    .io_data  ({1'h0, io_bus_dataIn[6:0]}),
    .io_tx    (io_uartTx),
    .io_ready (_tx_io_ready)
  );
  assign io_bus_hit = hitRcsr | hitRbuf | hitXcsr | io_bus_address == 22'h3FFF76;
  assign io_bus_dataOut =
    hitRcsr
      ? {8'h0, rxDone, rxIe, 6'h0}
      : hitRbuf ? {8'h0, rxData} : hitXcsr ? {8'h0, _tx_io_ready, txIe, 6'h0} : 16'h0;
  assign io_irq = rxPending | txPending;
  assign io_vector = {13'h6, ~rxPending, 2'h0};
endmodule

